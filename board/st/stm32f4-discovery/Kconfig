## board/st/stm32f4-discovery/Kconfig
```kconfig
if TARGET_STM32F4_DISCOVERY

config SYS_BOARD
	string
	default "stm32f4-discovery"

config SYS_VENDOR
	string
	default "st"

config SYS_SOC
	string
	default "stm32f4"

config SYS_CONFIG_NAME
	string
	default "stm32f4-discovery"

endif
```
